## CMakeLists.txt
```
# Copyright (c) 2026 Lingao Meng
# SPDX-License-Identifier: Apache-2.0
#
# ZBot - An open-source embedded AI Agent for Zephyr RTOS
# Target: nRF7002-DK (nRF5340 + nRF7002 WiFi)

cmake_minimum_required(VERSION 3.20.0)

find_package(Zephyr REQUIRED HINTS $ENV{ZEPHYR_BASE})

project(ZBot VERSION 0.1.0)

target_sources(app PRIVATE
    src/main.c
    src/tools.c
    src/memory.c
    src/config.c
    src/llm_client.c
    src/agent.c
    src/skill.c
    src/shell_cmd.c
)

target_include_directories(app PRIVATE src)
```

## prj.conf
```kconfig
# =============================================================================
# ZBot - Zephyr AI Agent Configuration
# Target: nRF7002-DK (nRF5340 + nRF7002 WiFi)
# =============================================================================

# --- Kernel / Stack ---
CONFIG_MAIN_STACK_SIZE=8192
CONFIG_SYSTEM_WORKQUEUE_STACK_SIZE=16384

CONFIG_PRINTK=y

# --- Shell (for runtime key configuration) ---
CONFIG_SHELL=y
CONFIG_SHELL_BACKEND_SERIAL=y
CONFIG_SHELL_STACK_SIZE=8192
CONFIG_SHELL_CMD_BUFF_SIZE=512
CONFIG_SHELL_HISTORY=y
CONFIG_SHELL_HISTORY_BUFFER=512

# --- Networking ---
CONFIG_NETWORKING=y
CONFIG_NET_IPV4=y
CONFIG_NET_TCP=y
CONFIG_NET_SOCKETS=y
# NOTE: CONFIG_NET_SOCKETS_POSIX_NAMES is deprecated since Zephyr 3.7.
# Socket calls use the zsock_* prefix directly (no POSIX_API needed).
# See: zephyr/doc/releases/migration-guide-3.7.rst #69950
CONFIG_DNS_RESOLVER=y
# Use DHCP-assigned DNS so internal domains (e.g. api.openai.com) resolve.
CONFIG_DNS_SERVER_IP_ADDRESSES=n

# --- Network buffers ---
CONFIG_NET_PKT_RX_COUNT=8
CONFIG_NET_PKT_TX_COUNT=8
CONFIG_NET_BUF_RX_COUNT=64
CONFIG_NET_BUF_TX_COUNT=64
# NET_BUF_DATA_SIZE depends on NET_BUF_FIXED_DATA_SIZE; enable the guard first.
CONFIG_NET_BUF_FIXED_DATA_SIZE=y
CONFIG_NET_BUF_DATA_SIZE=256

# --- WiFi (nRF7002) ---
# WIFI_NRF7002 is auto-selected by DT (DT_HAS_NORDIC_NRF7002_QSPI_ENABLED).
# WIFI_NM_WPA_SUPPLICANT is auto-selected by the nrf_wifi driver.
# Do NOT set WIFI_NRF700X or WPA_SUPP — those symbols no longer exist.
CONFIG_WIFI=y
CONFIG_NET_L2_WIFI_MGMT=y
CONFIG_NET_DHCPV4=y
# WiFi connection is handled by 'zbot wifi' commands (shell_cmd.c).
# The built-in wifi shell is intentionally disabled to keep the command
# surface under the single 'zbot' root.

# --- HTTP Client ---
CONFIG_HTTP_CLIENT=y

# --- TLS / mbedTLS ---
CONFIG_MBEDTLS=y
CONFIG_MBEDTLS_BUILTIN=y
CONFIG_NET_SOCKETS_SOCKOPT_TLS=y
CONFIG_TLS_CREDENTIALS=y
# MBEDTLS_HEAP_SIZE lives inside "if MBEDTLS_ENABLE_HEAP"
CONFIG_MBEDTLS_ENABLE_HEAP=y
CONFIG_MBEDTLS_HEAP_SIZE=32768
CONFIG_MBEDTLS_SSL_MAX_CONTENT_LEN=8192
# TLS 1.2 ciphersuite — required to pull in the SSL module (mbedtls_ssl_*).
# Without at least one ciphersuite, MBEDTLS_SSL_PROTO_TLS1_2 is never selected
# and all mbedtls_ssl_init/setup/handshake/... symbols are absent at link time.
CONFIG_MBEDTLS_CIPHERSUITE_TLS_ECDHE_RSA_WITH_AES_128_CBC_SHA256=y

# --- WiFi Credentials (Zephyr built-in, uses SETTINGS+NVS backend) ---
# wifi_credentials stores SSID/pass; NET_REQUEST_WIFI_CONNECT_STORED iterates them.
CONFIG_WIFI_CREDENTIALS=y
CONFIG_WIFI_CREDENTIALS_BACKEND_SETTINGS=y
CONFIG_WIFI_CREDENTIALS_CONNECT_STORED=y

CONFIG_SETTINGS=y
CONFIG_SETTINGS_RUNTIME=y
CONFIG_SETTINGS_NVS=y

CONFIG_NVS=y
CONFIG_FLASH=y
CONFIG_FLASH_MAP=y

# --- JSON parser ---
CONFIG_JSON_LIBRARY=y

# --- Logging ---
CONFIG_LOG=y
CONFIG_LOG_DEFAULT_LEVEL=3
CONFIG_PRINTK=y
# Use immediate (synchronous) log mode so output appears right away on UART,
# even before the shell thread is fully initialised. The default deferred mode
# queues messages into the shell log backend which only flushes once the shell
# is running — causing all early boot logs to be silently dropped.
CONFIG_LOG_MODE_IMMEDIATE=y

# --- Entropy / RNG ---
# nRF5340 app core has no RNG peripheral in its DTS. The psa-crypto-rng driver
# crashes at PRE_KERNEL_1 (heap not ready). Instead:
#   - TEST_RANDOM_GENERATOR: allows a non-CSPRNG source to satisfy sys_rand_get
#   - TIMER_RANDOM_GENERATOR: provides z_impl_sys_rand_get via system timer
#     (sufficient for TCP ISN and DHCP; not used for TLS key material)
# TLS/mbedTLS crypto RNG is provided by MBEDTLS_PSA_CRYPTO_EXTERNAL_RNG
# which is already set in the board defconfig and uses the software PSA backend.
CONFIG_ENTROPY_GENERATOR=y
CONFIG_TEST_RANDOM_GENERATOR=y
CONFIG_TIMER_RANDOM_GENERATOR=y

# --- Reboot support ---
CONFIG_REBOOT=y
```

## boards/nrf7002dk_nrf5340_cpuapp.overlay
```dts
/*
 * SPDX-License-Identifier: Apache-2.0
 * nRF7002-DK device tree overlay for ZBot
 *
 * Ensures storage_partition exists for NVS.
 * The nRF7002-DK (nRF5340) internal flash layout already includes a
 * storage partition in the upstream DTS; this overlay confirms it.
 */

/ {
    chosen {
        zephyr,console = &uart0;
        zephyr,shell-uart = &uart0;
        /*
         * Do NOT add zephyr,entropy here.
         * nRF5340 app core has no RNG peripheral in DTS.
         * The psa-crypto-rng driver calls psa_crypto_init() at PRE_KERNEL_1
         * before the heap is ready, causing a hard fault with no output.
         * Instead, use TEST_RANDOM_GENERATOR + TIMER_RANDOM_GENERATOR in prj.conf
         * to satisfy sys_rand_get(). TLS crypto RNG is handled separately by
         * MBEDTLS_PSA_CRYPTO_EXTERNAL_RNG (set in board defconfig).
         */
    };
};

/*
 * Ensure NVS storage partition is available.
 * On nRF5340 the storage partition is typically defined in:
 *   boards/nordic/nrf7002dk/nrf5340_cpuapp_common.dtsi
 * If it is missing on your SDK version, uncomment and adjust below:
 */

/*
&flash0 {
    partitions {
        compatible = "fixed-partitions";
        #address-cells = <1>;
        #size-cells = <1>;

        boot_partition: partition@0 {
            label = "mcuboot";
            reg = <0x00000000 0x00010000>;
        };

        slot0_partition: partition@10000 {
            label = "image-0";
            reg = <0x00010000 0x00070000>;
        };

        slot1_partition: partition@80000 {
            label = "image-1";
            reg = <0x00080000 0x00070000>;
        };

        storage_partition: partition@f0000 {
            label = "storage";
            reg = <0x000f0000 0x00008000>;
        };
    };
};
*/
```

## src/main.c
```c
/*
 * Copyright (c) 2026 Lingao Meng
 * SPDX-License-Identifier: Apache-2.0
 *
 * ZBot - Main Entry Point
 *
 * Boot sequence:
 *   1. memory_init()  — NVS mount, load persisted summary ("zbot/summary")
 *   2. config_init()  — load API key + WiFi credentials from flash, trigger
 *                       auto-connect if credentials were previously saved
 *   3. skills_register_builtins()
 *   4. agent_init()
 *   5. Register WiFi event callback (connect/disconnect notifications)
 *   6. Print welcome banner
 *   7. Idle — all interaction via Shell commands (zbot ...)
 *
 * WiFi:
 *   Use 'zbot wifi connect <ssid> [pass]' to connect and save credentials.
 *   On next boot, config_init() auto-connects using the saved credentials.
 *
 * API key:
 *   'zbot key <key>'      — set in RAM for this session
 *   'zbot key-save'       — persist to flash (optional)
 */

#include <zephyr/kernel.h>
#include <zephyr/logging/log.h>
#include <zephyr/net/net_if.h>
#include <zephyr/net/net_event.h>
#include <zephyr/net/wifi_mgmt.h>

#include "config.h"
#include "memory.h"
#include "agent.h"
#include "skill.h"
#include "tools.h"

LOG_MODULE_REGISTER(zbot_main, LOG_LEVEL_INF);

#define WIFI_MGMT_EVENTS (NET_EVENT_WIFI_CONNECT_RESULT | NET_EVENT_WIFI_DISCONNECT_RESULT)

static struct net_mgmt_event_callback g_wifi_cb;
static K_SEM_DEFINE(g_wifi_connected_sem, 0, 1);
static volatile bool g_wifi_connected = false;

static void wifi_event_handler(struct net_mgmt_event_callback *cb, uint64_t mgmt_event,
			       struct net_if *iface)
{
	if (mgmt_event == NET_EVENT_WIFI_CONNECT_RESULT) {
		const struct wifi_status *status = (const struct wifi_status *)cb->info;
		if (status->status == 0) {
			LOG_INF("WiFi connected!");
			g_wifi_connected = true;
			k_sem_give(&g_wifi_connected_sem);
		} else {
			LOG_WRN("WiFi connect failed (status %d)", status->status);
		}
	} else if (mgmt_event == NET_EVENT_WIFI_DISCONNECT_RESULT) {
		LOG_WRN("WiFi disconnected");
		g_wifi_connected = false;
	}
}

static void print_banner(void)
{
	printk("\n");
	printk("╔══════════════════════════════════════════════╗\n");
	printk("║        ZBot - Embedded AI Agent              ║\n");
	printk("║   Board: nRF7002-DK  |  RTOS: Zephyr         ║\n");
	printk("║   Version: 0.1.0     |  License: Apache-2.0  ║\n");
	printk("╚══════════════════════════════════════════════╝\n");
	printk("\n");
	printk("Quick start:\n");
	printk("  1. Connect to WiFi (saves credentials for auto-connect):\n");
	printk("       zbot wifi connect <SSID> <password>\n");
	printk("  2. Set API key:\n");
	printk("       zbot key sk-...          -- RAM only (cleared on reboot)\n");
	printk("       zbot key-save            -- also persist to flash\n");
	printk("  3. [Optional] Change model/endpoint:\n");
	printk("       zbot model gpt-4o-mini\n");
	printk("       zbot host api.openai.com\n");
	printk("  4. Chat:\n");
	printk("       zbot chat Hello! What can you do?\n");
	printk("  5. Other commands:\n");
	printk("       zbot status              -- show config + WiFi SSID\n");
	printk("       zbot wifi status         -- show saved WiFi SSID\n");
	printk("       zbot history             -- show conversation\n");
	printk("       zbot summary             -- show NVS summary\n");
	printk("       zbot skill list\n");
	printk("       zbot tools\n");
	printk("\n");
}

int main(void)
{
	int rc;

	printk("Start\n");

	/* 1. Memory — NVS mount and load persisted summary */
	rc = memory_init();
	if (rc < 0) {
		LOG_WRN("Memory/NVS init warning: %d (continuing without persistence)", rc);
	}

	/* 2. Config — load API key + WiFi credentials from NVS; auto-connect WiFi */
	config_init();

	/* 3. Skills */
	skills_register_builtins();

	/* 4. Agent */
	rc = agent_init();
	if (rc < 0) {
		LOG_ERR("Agent init failed: %d", rc);
		return rc;
	}

	/* 5. Register WiFi event callback */
	net_mgmt_init_event_callback(&g_wifi_cb, wifi_event_handler, WIFI_MGMT_EVENTS);
	net_mgmt_add_event_callback(&g_wifi_cb);

	/* 6. Print banner */
	print_banner();

	/* Log persisted summary if available */
	const char *summary = memory_get_summary();
	if (summary != NULL) {
		LOG_DBG("Loaded prior context from NVS: %.80s...", summary);
		printk("  [Prior session context loaded from NVS]\n\n");
	}

	/* 7. Idle — shell handles everything else */
	while (1) {
		k_sleep(K_SECONDS(30));

		if (g_wifi_connected) {
			LOG_DBG("Heartbeat — WiFi up");
		}
	}

	return 0;
}
```

## src/agent.c
```c
/*
 * Copyright (c) 2026 Lingao Meng
 *
 * SPDX-License-Identifier: Apache-2.0
 *
 * ZBot - Agent Module Implementation
 *
 * Implements the ReAct (Reason + Act) loop for tool-augmented LLM interaction.
 */

#include <zephyr/kernel.h>
#include <zephyr/logging/log.h>
#include <string.h>
#include <stdio.h>
#include <errno.h>

#include "agent.h"
#include "memory.h"
#include "tools.h"
#include "llm_client.h"

LOG_MODULE_REGISTER(zbot_agent, LOG_LEVEL_INF);

/* Static buffers (large, stack-allocated per call would overflow) */
static char g_tool_result[TOOLS_RESULT_MAX_LEN];

struct summary_ctx {
	const char *roles[MEMORY_COMPRESS_COUNT];
	const char *contents[MEMORY_COMPRESS_COUNT];
	const char *prior;
	int count;
};

static int summary_messages_cb(char *buf, size_t buf_len, void *args)
{
	struct summary_ctx *ctx = args;
	size_t pos = 0;
	int n;

	n = snprintf(buf + pos, buf_len - pos, "[{\"role\":\"system\",\"content\":\"%s\"},",
		     AGENT_SYSTEM_PROMPT);
	if (n < 0 || (size_t)n >= buf_len - pos) {
		return -ENOMEM;
	}

	pos += (size_t)n;

	if (ctx->prior != NULL) {
		n = snprintf(buf + pos, buf_len - pos,
			     "{\"role\":\"user\",\"content\":\"[Prior summary] %s\"},"
			     "{\"role\":\"assistant\",\"content\":\"Understood.\"},",
			     ctx->prior);
		if (n < 0 || pos + (size_t)n >= buf_len) {
			return -ENOMEM;
		}

		pos += (size_t)n;
	}

	n = snprintf(buf + pos, buf_len - pos, "{\"role\":\"user\",\"content\":\"%s\\n",
		     (ctx->prior != NULL)
			     ? "Update the prior summary to include the following new turns. "
			       "Keep the result under 3 sentences, factual and concise."
			     : "Summarise the following conversation in 2-3 sentences "
			       "for future context. Be factual and concise.");
	if (n < 0 || pos + (size_t)n >= buf_len) {
		return -ENOMEM;
	}

	pos += (size_t)n;

	for (int i = 0; i < ctx->count; i++) {
		n = snprintf(buf + pos, buf_len - pos, "%s: %s\\n", ctx->roles[i],
			     ctx->contents[i]);
		if (n < 0 || pos + (size_t)n >= buf_len) {
			return -ENOMEM;
		}

		pos += (size_t)n;
	}

	n = snprintf(buf + pos, buf_len - pos, "\"}]");
	if (n < 0 || pos + (size_t)n >= buf_len) {
		return -ENOMEM;
	}

	pos += (size_t)n;

	return (int)pos;
}

int agent_request_summary(agent_format_fn_t format_fn, char *out_buf, size_t out_len)
{
	struct summary_ctx ctx;
	struct llm_response resp;
	int count, rc;

	if (!format_fn || !out_buf || out_len == 0) {
		return -EINVAL;
	}

	count = format_fn(ctx.roles, ctx.contents, MEMORY_COMPRESS_COUNT);
	if (count < 0) {
		return count;
	}

	if (count == 0) {
		return -ENODATA;
	}

	ctx.count = count;
	ctx.prior = memory_get_summary();

	rc = llm_chat(summary_messages_cb, NULL, &resp, &ctx);
	if (rc == 0 && resp.content[0] != '\0') {
		strncpy(out_buf, resp.content, out_len - 1);
		out_buf[out_len - 1] = '\0';
		LOG_INF("agent_request_summary: %zu chars", strlen(out_buf));
		return 0;
	}

	LOG_WRN("agent_request_summary failed: %d", rc);

	return rc != 0 ? rc : -ENODATA;
}

static int messages_cb(char *buf, size_t buf_len, void *args)
{
	ARG_UNUSED(args);

	return memory_build_messages_json(buf, buf_len);
}

static int tools_cb(char *buf, size_t buf_len, void *args)
{
	ARG_UNUSED(args);

	return tools_build_json(buf, buf_len);
}

/* ------------------------------------------------------------------ */
/* ------------------------------------------------------------------ */

static int react_loop(const char *user_input, char *out_buf, size_t out_len)
{
	struct llm_response resp;
	int iterations = 0;
	int rc;

	/* Add user turn to history */
	rc = memory_add_turn("user", user_input);
	if (rc < 0) {
		LOG_ERR("Failed to add user turn: %d", rc);
		return rc;
	}

	while (iterations < AGENT_MAX_REACT_ITERATIONS) {
		iterations++;

		LOG_INF("ReAct iteration %d / %d", iterations, AGENT_MAX_REACT_ITERATIONS);

		/* Call LLM — messages and tools JSON built directly into req_body */
		rc = llm_chat(messages_cb, tools_cb, &resp, NULL);
		if (rc < 0) {
			LOG_ERR("LLM call failed: %d", rc);
			snprintf(out_buf, out_len, "[Error: LLM request failed (%d)]", rc);
			return rc;
		}

		/* --- Tool call branch --- */
		if (resp.finish_reason == LLM_FINISH_TOOL_CALL && resp.has_tool_call) {
			LOG_INF("Tool requested: %s(%s)", resp.tool_call.name,
				resp.tool_call.arguments);

			/* Execute the tool */
			rc = tools_execute(resp.tool_call.name, resp.tool_call.arguments,
					   g_tool_result, sizeof(g_tool_result));

			LOG_INF("Tool result: %s", g_tool_result);

			/* Continue loop — let LLM process tool result */
			continue;
		}

		/* --- Stop / final response --- */
		if (resp.content[0] != '\0') {
			strncpy(out_buf, resp.content, out_len - 1);
			out_buf[out_len - 1] = '\0';

			/* Add assistant response to history */
			memory_add_turn("assistant", resp.content);
			return 0;
		}

		/* Empty response — stop */
		LOG_WRN("Empty LLM response");

		snprintf(out_buf, out_len, "[No response from model]");

		return -ENODATA;
	}

	/* Max iterations reached */
	LOG_WRN("Max ReAct iterations reached");

	snprintf(out_buf, out_len, "[Max tool iterations (%d) reached. Last result: %s]",
		 AGENT_MAX_REACT_ITERATIONS, g_tool_result);

	return -ELOOP;
}

/* ------------------------------------------------------------------ */
/* ------------------------------------------------------------------ */

int agent_init(void)
{
	LOG_INF("zbot agent initialised (max ReAct iterations: %d)", AGENT_MAX_REACT_ITERATIONS);

	return 0;
}

static void agent_work_handler(struct k_work *work);

static struct agent_work_item {
	struct k_work work;
	char input[AGENT_INPUT_MAX_LEN];
	struct agent_response_ctx ctx;
} g_work_item = {
	.work = Z_WORK_INITIALIZER(agent_work_handler),
};

bool agent_is_busy(void)
{
	return k_work_busy_get(&g_work_item.work) & (K_WORK_RUNNING | K_WORK_QUEUED);
}

static void agent_work_handler(struct k_work *work)
{
	struct agent_work_item *item = CONTAINER_OF(work, struct agent_work_item, work);
	int rc;

	rc = react_loop(item->input, item->ctx.output, item->ctx.output_length);

	if (item->ctx.cb) {
		item->ctx.cb(rc, &item->ctx);
	}
}

int agent_submit_input(const char *input, const struct agent_response_ctx *ctx)
{
	if (!input || strlen(input) == 0 || !ctx || !ctx->output) {
		return -EINVAL;
	}

	if (agent_is_busy()) {
		LOG_WRN("Agent is busy");
		return -EBUSY;
	}

	if (strlen(input) >= AGENT_INPUT_MAX_LEN) {
		LOG_ERR("Input too long (%zu > %d)", strlen(input), AGENT_INPUT_MAX_LEN - 1);
		return -EINVAL;
	}

	strncpy(g_work_item.input, input, AGENT_INPUT_MAX_LEN - 1);
	g_work_item.input[AGENT_INPUT_MAX_LEN - 1] = '\0';

	g_work_item.ctx = *ctx;

	k_work_submit(&g_work_item.work);

	return 0;
}
```

## src/config.c
```c
/*
 * Copyright (c) 2026 Lingao Meng
 *
 * SPDX-License-Identifier: Apache-2.0
 *
 * ZBot - Config Module Implementation
 */

#include <zephyr/kernel.h>
#include <zephyr/logging/log.h>
#include <zephyr/settings/settings.h>
#include <zephyr/net/net_if.h>
#include <zephyr/net/wifi_mgmt.h>
#include <zephyr/net/wifi_credentials.h>
#include <string.h>
#include <errno.h>

#include "config.h"

LOG_MODULE_REGISTER(zbot_config, LOG_LEVEL_INF);

#define DEFAULT_ENDPOINT_HOST "api.openai.com"
#define DEFAULT_ENDPOINT_PATH "/v1/chat/completions"
#define DEFAULT_MODEL         "gpt-5.2"
#define DEFAULT_PROVIDER_ID   "azure_openai"
#define DEFAULT_MAX_TOKENS    512
#define DEFAULT_TEMP_X100     70

static struct llm_config g_cfg = {
	.use_tls = true,
	.port = 443,
	.max_tokens = DEFAULT_MAX_TOKENS,
	.temperature_x100 = DEFAULT_TEMP_X100,
	.endpoint_host = DEFAULT_ENDPOINT_HOST,
	.endpoint_path = DEFAULT_ENDPOINT_PATH,
	.model = DEFAULT_MODEL,
	.provider_id = DEFAULT_PROVIDER_ID,
};

/* ------------------------------------------------------------------ */
/* Settings handler — loads all persisted fields at boot              */
/* ------------------------------------------------------------------ */

static int zc_config_set(const char *name, size_t len, settings_read_cb read_cb, void *cb_arg)
{
	size_t read_len;
	int rc;

	if (strcmp(name, "apikey") == 0) {
		read_len = MIN(len, sizeof(g_cfg.api_key) - 1);
		rc = read_cb(cb_arg, g_cfg.api_key, read_len);
		if (rc >= 0) {
			g_cfg.api_key[read_len] = '\0';
		}
		return rc < 0 ? rc : 0;
	}

	if (strcmp(name, "host") == 0) {
		read_len = MIN(len, sizeof(g_cfg.endpoint_host) - 1);
		rc = read_cb(cb_arg, g_cfg.endpoint_host, read_len);
		if (rc >= 0) {
			g_cfg.endpoint_host[read_len] = '\0';
		}
		return rc < 0 ? rc : 0;
	}

	if (strcmp(name, "path") == 0) {
		read_len = MIN(len, sizeof(g_cfg.endpoint_path) - 1);
		rc = read_cb(cb_arg, g_cfg.endpoint_path, read_len);
		if (rc >= 0) {
			g_cfg.endpoint_path[read_len] = '\0';
		}
		return rc < 0 ? rc : 0;
	}

	if (strcmp(name, "model") == 0) {
		read_len = MIN(len, sizeof(g_cfg.model) - 1);
		rc = read_cb(cb_arg, g_cfg.model, read_len);
		if (rc >= 0) {
			g_cfg.model[read_len] = '\0';
		}
		return rc < 0 ? rc : 0;
	}

	if (strcmp(name, "provider_id") == 0) {
		read_len = MIN(len, sizeof(g_cfg.provider_id) - 1);
		rc = read_cb(cb_arg, g_cfg.provider_id, read_len);
		if (rc >= 0) {
			g_cfg.provider_id[read_len] = '\0';
		}
		return rc < 0 ? rc : 0;
	}

	if (strcmp(name, "use_tls") == 0 && len == sizeof(uint8_t)) {
		uint8_t v;

		rc = read_cb(cb_arg, &v, sizeof(v));
		if (rc >= 0) {
			g_cfg.use_tls = (bool)v;
		}
		return rc < 0 ? rc : 0;
	}

	if (strcmp(name, "port") == 0 && len == sizeof(uint16_t)) {
		rc = read_cb(cb_arg, &g_cfg.port, sizeof(g_cfg.port));
		return rc < 0 ? rc : 0;
	}

	return -ENOENT;
}

SETTINGS_STATIC_HANDLER_DEFINE(zc_config, "zbot", NULL, zc_config_set, NULL, NULL);

/* ------------------------------------------------------------------ */
/* Init                                                               */
/* ------------------------------------------------------------------ */

void config_init(void)
{
	/* settings_subsys_init() and settings_load_subtree("zbot") are called
	 * by memory_init() before config_init(). Our handler above will have
	 * already overwritten the defaults with any persisted values. */

	if (g_cfg.api_key[0] != '\0') {
		printk("[config] API key loaded from flash.\n");
	} else {
		printk("[config] No API key stored. Use: zbot key <key>\n");
	}

	LOG_INF("Config init. Endpoint: %s%s model: %s", g_cfg.endpoint_host,
		g_cfg.endpoint_path, g_cfg.model);

	/* Auto-connect WiFi if credentials were saved in wifi_credentials */
	if (!wifi_credentials_is_empty()) {
		printk("[config] WiFi credentials found — auto-connecting...\n");
		int rc = config_wifi_auto_connect();

		if (rc < 0) {
			LOG_WRN("WiFi auto-connect request failed: %d", rc);
		}
	}
}

/* ------------------------------------------------------------------ */
/* Getters / setters                                                  */
/* ------------------------------------------------------------------ */

const struct llm_config *config_get(void)
{
	return &g_cfg;
}

int config_set_api_key(const char *key)
{
	int rc;

	if (!key || strlen(key) >= CONFIG_API_KEY_MAX_LEN) {
		return -EINVAL;
	}

	strncpy(g_cfg.api_key, key, sizeof(g_cfg.api_key) - 1);
	g_cfg.api_key[sizeof(g_cfg.api_key) - 1] = '\0';

	rc = settings_save_one("zbot/apikey", g_cfg.api_key, strlen(g_cfg.api_key) + 1);
	if (rc < 0) {
		LOG_ERR("Failed to persist api_key: %d", rc);
	}

	return rc;
}

int config_set_endpoint_host(const char *host)
{
	int rc;

	if (!host || strlen(host) >= CONFIG_ENDPOINT_MAX_LEN) {
		return -EINVAL;
	}

	strncpy(g_cfg.endpoint_host, host, sizeof(g_cfg.endpoint_host) - 1);
	g_cfg.endpoint_host[sizeof(g_cfg.endpoint_host) - 1] = '\0';

	rc = settings_save_one("zbot/host", g_cfg.endpoint_host,
			       strlen(g_cfg.endpoint_host) + 1);
	if (rc < 0) {
		LOG_ERR("Failed to persist host: %d", rc);
	}

	return rc;
}

int config_set_endpoint_path(const char *path)
{
	int rc;

	if (!path || strlen(path) >= CONFIG_ENDPOINT_MAX_LEN) {
		return -EINVAL;
	}

	strncpy(g_cfg.endpoint_path, path, sizeof(g_cfg.endpoint_path) - 1);
	g_cfg.endpoint_path[sizeof(g_cfg.endpoint_path) - 1] = '\0';

	rc = settings_save_one("zbot/path", g_cfg.endpoint_path,
			       strlen(g_cfg.endpoint_path) + 1);
	if (rc < 0) {
		LOG_ERR("Failed to persist path: %d", rc);
	}

	return rc;
}

int config_set_model(const char *model)
{
	int rc;

	if (!model || strlen(model) >= CONFIG_MODEL_MAX_LEN) {
		return -EINVAL;
	}

	strncpy(g_cfg.model, model, sizeof(g_cfg.model) - 1);
	g_cfg.model[sizeof(g_cfg.model) - 1] = '\0';

	rc = settings_save_one("zbot/model", g_cfg.model, strlen(g_cfg.model) + 1);
	if (rc < 0) {
		LOG_ERR("Failed to persist model: %d", rc);
	}

	return rc;
}

int config_set_provider_id(const char *provider_id)
{
	int rc;

	if (!provider_id || strlen(provider_id) >= CONFIG_PROVIDER_ID_MAX_LEN) {
		return -EINVAL;
	}

	strncpy(g_cfg.provider_id, provider_id, sizeof(g_cfg.provider_id) - 1);
	g_cfg.provider_id[sizeof(g_cfg.provider_id) - 1] = '\0';

	rc = settings_save_one("zbot/provider_id", g_cfg.provider_id,
			       strlen(g_cfg.provider_id) + 1);
	if (rc < 0) {
		LOG_ERR("Failed to persist provider_id: %d", rc);
	}

	return rc;
}

int config_set_tls(bool use_tls, uint16_t port)
{
	uint8_t v = (uint8_t)use_tls;
	int rc;

	g_cfg.use_tls = use_tls;
	g_cfg.port = port;

	rc = settings_save_one("zbot/use_tls", &v, sizeof(v));
	if (rc < 0) {
		LOG_ERR("Failed to persist use_tls: %d", rc);
		return rc;
	}

	rc = settings_save_one("zbot/port", &g_cfg.port, sizeof(g_cfg.port));
	if (rc < 0) {
		LOG_ERR("Failed to persist port: %d", rc);
	}

	return rc;
}

bool config_has_api_key(void)
{
	return g_cfg.api_key[0] != '\0';
}

int config_delete_api_key(void)
{
	memset(g_cfg.api_key, 0, sizeof(g_cfg.api_key));

	return settings_delete("zbot/apikey");
}

void config_print_status(void)
{
	printk("=== ZBot Config ===\n");
	printk("  Endpoint : %s:%u%s\n", g_cfg.endpoint_host, g_cfg.port, g_cfg.endpoint_path);
	printk("  Model    : %s\n", g_cfg.model);
	printk("  Provider : %s\n", g_cfg.provider_id[0] ? g_cfg.provider_id : "(not set)");
	printk("  TLS      : %s\n", g_cfg.use_tls ? "yes" : "no");
	printk("  API Key  : %s\n", g_cfg.api_key[0] ? "*** (set)" : "(not set)");
	printk("  Max Tok  : %d\n", g_cfg.max_tokens);
	printk("  Temp     : %d.%02d\n", g_cfg.temperature_x100 / 100,
	       g_cfg.temperature_x100 % 100);
	printk("  WiFi cred: %s\n", wifi_credentials_is_empty() ? "(not saved)" : "(saved)");
}

/* ------------------------------------------------------------------ */
/* WiFi helpers (backed by Zephyr wifi_credentials subsystem)         */
/* ------------------------------------------------------------------ */

int config_wifi_connect(const char *ssid, const char *pass)
{
	struct net_if *iface = net_if_get_default();
	struct wifi_connect_req_params params = {0};
	enum wifi_security_type sec;
	int rc;

	if (!ssid || ssid[0] == '\0') {
		return -EINVAL;
	}

	if (!iface) {
		LOG_ERR("No default network interface");
		return -ENODEV;
	}

	sec = (pass && pass[0] != '\0') ? WIFI_SECURITY_TYPE_PSK : WIFI_SECURITY_TYPE_NONE;

	/* Persist via wifi_credentials subsystem (settings+NVS backend) */
	rc = wifi_credentials_set_personal(ssid, strlen(ssid), sec, NULL, 0, pass ? pass : "",
					   pass ? strlen(pass) : 0, 0, 0, 0);
	if (rc < 0) {
		LOG_ERR("Failed to save WiFi credentials: %d", rc);
		return rc;
	}

	/* Issue connect request immediately */
	params.ssid = (const uint8_t *)ssid;
	params.ssid_length = strlen(ssid);
	params.security = sec;
	if (sec == WIFI_SECURITY_TYPE_PSK) {
		params.psk = (const uint8_t *)pass;
		params.psk_length = strlen(pass);
	}
	params.channel = WIFI_CHANNEL_ANY;
	params.band = WIFI_FREQ_BAND_UNKNOWN;
	params.mfp = WIFI_MFP_OPTIONAL;

	return net_mgmt(NET_REQUEST_WIFI_CONNECT, iface, &params, sizeof(params));
}

int config_wifi_disconnect(void)
{
	struct net_if *iface = net_if_get_default();

	if (!iface) {
		return -ENODEV;
	}

	return net_mgmt(NET_REQUEST_WIFI_DISCONNECT, iface, NULL, 0);
}

int config_wifi_auto_connect(void)
{
	struct net_if *iface = net_if_get_default();

	if (wifi_credentials_is_empty()) {
		return -ENOENT;
	}

	if (!iface) {
		return -ENODEV;
	}

	/* wifi_credentials subsystem iterates stored networks and connects */
	return net_mgmt(NET_REQUEST_WIFI_CONNECT_STORED, iface, NULL, 0);
}
```

## src/config.h
```c
/*
 * Copyright (c) 2026 Lingao Meng
 *
 * SPDX-License-Identifier: Apache-2.0
 *
 * ZBot - Config Module
 *
 * Runtime LLM configuration persisted to NVS via Zephyr settings subsystem.
 * Every config_set_*() call writes through to flash immediately.
 * Settings are loaded back at boot inside config_init().
 *
 * Persistent keys (subtree "zbot"):
 *   "zbot/apikey"      : API key
 *   "zbot/host"        : LLM endpoint host
 *   "zbot/path"        : LLM endpoint path
 *   "zbot/model"       : model name
 *   "zbot/provider_id" : X-Model-Provider-Id header value
 *   "zbot/use_tls"     : TLS enabled flag (uint8_t)
 *   "zbot/port"        : TCP port (uint16_t)
 *
 * Note: "zbot/summary" is managed by memory.c under the same subtree.
 * WiFi credentials are stored by the Zephyr wifi_credentials subsystem.
 */

#ifndef ZBOT_CONFIG_H
#define ZBOT_CONFIG_H

#include <stdbool.h>
#include <stdint.h>
#include <stddef.h>

#ifdef __cplusplus
extern "C" {
#endif

/* Field size limits */
#define CONFIG_API_KEY_MAX_LEN     256
#define CONFIG_ENDPOINT_MAX_LEN    128
#define CONFIG_MODEL_MAX_LEN       64
#define CONFIG_PROVIDER_ID_MAX_LEN 64

/**
 * @brief Runtime LLM configuration — all fields persisted to NVS.
 */
struct llm_config {
	char api_key[CONFIG_API_KEY_MAX_LEN];
	char endpoint_host[CONFIG_ENDPOINT_MAX_LEN];
	char endpoint_path[CONFIG_ENDPOINT_MAX_LEN];
	char model[CONFIG_MODEL_MAX_LEN];
	char provider_id[CONFIG_PROVIDER_ID_MAX_LEN];
	bool use_tls;
	uint16_t port;
	int max_tokens;
	int temperature_x100; /* stored as int, e.g. 70 = 0.7 */
};

/**
 * @brief Initialise config with defaults, then reload all persisted values
 *        from NVS.  Must be called after settings_subsys_init().
 */
void config_init(void);

/** @brief Get read-only pointer to the current runtime config. */
const struct llm_config *config_get(void);

/** @brief Set API key and persist to flash. */
int config_set_api_key(const char *key);

/** @brief Set LLM endpoint host and persist to flash. */
int config_set_endpoint_host(const char *host);

/** @brief Set API path and persist to flash. */
int config_set_endpoint_path(const char *path);

/** @brief Set model name and persist to flash. */
int config_set_model(const char *model);

/** @brief Set X-Model-Provider-Id header value and persist to flash. */
int config_set_provider_id(const char *provider_id);

/** @brief Set TLS mode and port and persist to flash. */
int config_set_tls(bool use_tls, uint16_t port);

/** @brief Check whether an API key is set in RAM. */
bool config_has_api_key(void);

/** @brief Delete the API key from RAM and flash. */
int config_delete_api_key(void);

/**
 * @brief Save WiFi credentials via wifi_credentials subsystem and connect.
 *
 * @param ssid  Network SSID.
 * @param pass  Passphrase, or NULL/empty for open networks.
 * @return 0 on success, negative errno on failure.
 */
int config_wifi_connect(const char *ssid, const char *pass);

/** @brief Disconnect from current WiFi network. */
int config_wifi_disconnect(void);

/**
 * @brief Auto-connect using all credentials stored in wifi_credentials.
 *
 * Issues NET_REQUEST_WIFI_CONNECT_STORED on the default interface.
 * Called automatically on boot by config_init() if credentials exist.
 *
 * @return 0 if request was issued, -ENOENT if no credentials stored.
 */
int config_wifi_auto_connect(void);

/** @brief Print current config to serial (redacts API key). */
void config_print_status(void);

#ifdef __cplusplus
}
#endif

#endif /* ZBOT_CONFIG_H */
```

## src/llm_client.c
```c
/*
 * SPDX-License-Identifier: Apache-2.0
 * ZBot - LLM Client Implementation
 *
 * Uses Zephyr's BSD-socket API + HTTP client to call OpenAI-compatible APIs.
 * TLS (mbedTLS) is used for HTTPS. The CA certificate bundle must be provided
 * at build time (see ca_cert.h) or TLS verification can be skipped for dev.
 */

#include <zephyr/kernel.h>
#include <zephyr/logging/log.h>
#include <zephyr/net/socket.h>
#include <zephyr/net/tls_credentials.h>
#include <zephyr/net/http/client.h>
#include <string.h>
#include <stdio.h>
#include <errno.h>

#include "llm_client.h"
#include "config.h"

LOG_MODULE_REGISTER(zbot_llm, LOG_LEVEL_INF);

/* TLS credential tag for the CA certificate */
#define LLM_TLS_TAG 42

/* HTTP request timeout (ms) */
#define LLM_HTTP_TIMEOUT_MS 30000

/*
 * Extract a JSON string value from a buffer.
 * Handles simple cases needed for LLM responses.
 */
static int extract_json_str(const char *json, const char *key, char *out, size_t out_len)
{
	if (!json || !key || !out) {
		return -EINVAL;
	}

	char search[80];
	snprintf(search, sizeof(search), "\"%s\"", key);
	const char *pos = strstr(json, search);
	if (!pos) {
		return -ENOENT;
	}

	pos += strlen(search);
	while (*pos == ' ' || *pos == ':' || *pos == '\t') {
		pos++;
	}
	if (*pos == 'n') { /* null */
		out[0] = '\0';
		return 0;
	}
	if (*pos != '"') {
		return -ENOENT;
	}
	pos++;

	size_t i = 0;
	while (*pos != '\0' && i + 1 < out_len) {
		if (*pos == '\\') {
			pos++;
			if (*pos == 'n') {
				out[i++] = '\n';
			} else if (*pos == 't') {
				out[i++] = '\t';
			} else if (*pos == '"') {
				out[i++] = '"';
			} else if (*pos == '\\') {
				out[i++] = '\\';
			} else {
				out[i++] = *pos;
			}
			pos++;
		} else if (*pos == '"') {
			break;
		} else {
			out[i++] = *pos++;
		}
	}
	out[i] = '\0';
	return (int)i;
}

/*
 * Parse the OpenAI chat completion response JSON.
 * Handles both regular text responses and tool_call responses.
 */
static int parse_llm_response(const char *json, struct llm_response *resp)
{
	memset(resp, 0, sizeof(*resp));
	resp->finish_reason = LLM_FINISH_ERROR;

	if (!json || json[0] == '\0') {
		LOG_ERR("Empty response body");
		return -ENODATA;
	}

	/* Check for error response */
	if (strstr(json, "\"error\"")) {
		char err_msg[128] = {0};
		extract_json_str(json, "message", err_msg, sizeof(err_msg));
		LOG_ERR("LLM API error: %s", err_msg);
		return -EIO;
	}

	/* Extract finish_reason from choices[0].
	 * Some providers return finish_reason=null when tool_calls are present,
	 * so also check for the presence of a "tool_calls" array. */
	char finish_reason[32] = {0};
	extract_json_str(json, "finish_reason", finish_reason, sizeof(finish_reason));

	/* Detect tool_calls: must have the field AND it must not be null/empty.
	 * "tool_calls\":null" and "tool_calls\":[]" mean no tool call. */
	bool has_tool_calls_field = false;
	const char *tc_pos = strstr(json, "\"tool_calls\"");
	if (tc_pos) {
		/* Skip past the key to the value */
		const char *val = tc_pos + strlen("\"tool_calls\"");
		while (*val == ' ' || *val == ':' || *val == '\t') {
			val++;
		}
		/* Only treat as a real tool call if value starts with '[' (array)
		 * and the array is not empty '[]' */
		if (*val == '[' && *(val + 1) != ']') {
			has_tool_calls_field = true;
		}
	}

	if (strcmp(finish_reason, "tool_calls") == 0 || has_tool_calls_field) {
		resp->finish_reason = LLM_FINISH_TOOL_CALL;
		resp->has_tool_call = true;
	} else if (strcmp(finish_reason, "length") == 0) {
		resp->finish_reason = LLM_FINISH_LENGTH;
	} else {
		resp->finish_reason = LLM_FINISH_STOP;
	}

	/* Extract content */
	extract_json_str(json, "content", resp->content, LLM_CONTENT_MAX_LEN);

	/* Parse tool_calls if present */
	if (resp->has_tool_call) {
		const char *tc_pos = strstr(json, "\"tool_calls\"");
		if (tc_pos) {
			/* Extract tool call id */
			extract_json_str(tc_pos, "id", resp->tool_call.id,
					 sizeof(resp->tool_call.id));
			/* Extract function name */
			const char *fn_pos = strstr(tc_pos, "\"function\"");
			if (fn_pos) {
				extract_json_str(fn_pos, "name", resp->tool_call.name,
						 LLM_TOOL_NAME_MAX_LEN);
				/* Arguments is a JSON string (escaped JSON) */
				extract_json_str(fn_pos, "arguments", resp->tool_call.arguments,
						 LLM_TOOL_ARGS_MAX_LEN);
			}
			LOG_INF("Tool call: %s(%s)", resp->tool_call.name,
				resp->tool_call.arguments);
		}
	}

	return 0;
}

static int build_request_body(llm_messages_cb_t messages_cb, llm_tools_cb_t tools_cb, char *buf,
			      size_t buf_len, void *args)
{
	const struct llm_config *cfg = config_get();
	const size_t tools_key_len = 9; /* ",\"tools\":" */
	size_t pos = 0;
	int tools_n;
	int n;

	n = snprintf(buf + pos, buf_len - pos,
		     "{\"model\":\"%s\","
		     "\"max_completion_tokens\":%d,"
		     "\"messages\":",
		     cfg->model, cfg->max_tokens);
	if (n < 0 || (size_t)n >= buf_len - pos) {
		return -ENOMEM;
	}

	pos += n;

	n = messages_cb(buf + pos, buf_len - pos, args);
	if (n <= 0) {
		return n < 0 ? n : -EINVAL;
	}

	pos += n;

	if (tools_cb != NULL) {
		if (buf_len - pos < tools_key_len + 2) {
			return -ENOMEM;
		}

		tools_n = tools_cb(buf + pos + tools_key_len, buf_len - pos - tools_key_len, args);
		if (tools_n > 0) {
			memcpy(buf + pos, ",\"tools\":", tools_key_len);
			pos += tools_key_len + tools_n;

			n = snprintf(buf + pos, buf_len - pos, ",\"tool_choice\":\"auto\"");
			if (n < 0 || (size_t)n >= buf_len - pos) {
				return -ENOMEM;
			}

			pos += n;
		} else if (tools_n < 0) {
			return tools_n;
		}
	}

	n = snprintf(buf + pos, buf_len - pos, "}");
	if (n < 0 || (size_t)n >= buf_len - pos) {
		return -ENOMEM;
	}

	pos += n;
	return (int)pos;
}

static int resolve_and_connect(const struct llm_config *cfg)
{
	struct zsock_addrinfo hints = {0};
	struct zsock_addrinfo *res = NULL;
	char port_str[8];
	int sock = -1;

	hints.ai_family = AF_INET;
	hints.ai_socktype = SOCK_STREAM;

	snprintf(port_str, sizeof(port_str), "%u", cfg->port);

	int rc = zsock_getaddrinfo(cfg->endpoint_host, port_str, &hints, &res);
	if (rc != 0) {
		LOG_ERR("DNS resolution failed for %s: %d", cfg->endpoint_host, rc);
		return -EHOSTUNREACH;
	}

	if (cfg->use_tls) {
		sec_tag_t sec_tag_list[] = {LLM_TLS_TAG};

		sock = zsock_socket(AF_INET, SOCK_STREAM, IPPROTO_TLS_1_2);
		if (sock >= 0) {
			zsock_setsockopt(sock, SOL_TLS, TLS_SEC_TAG_LIST, sec_tag_list,
					 sizeof(sec_tag_list));
			zsock_setsockopt(sock, SOL_TLS, TLS_HOSTNAME, cfg->endpoint_host,
					 strlen(cfg->endpoint_host));
			/* For development: skip peer verify if no CA cert loaded */
			int verify = TLS_PEER_VERIFY_NONE;
			zsock_setsockopt(sock, SOL_TLS, TLS_PEER_VERIFY, &verify, sizeof(verify));
		}
	} else {
		sock = zsock_socket(AF_INET, SOCK_STREAM, IPPROTO_TCP);
	}

	if (sock < 0) {
		LOG_ERR("Failed to create socket: %d", errno);
		zsock_freeaddrinfo(res);
		return -errno;
	}

	rc = zsock_connect(sock, res->ai_addr, res->ai_addrlen);
	zsock_freeaddrinfo(res);

	if (rc < 0) {
		LOG_ERR("Connect failed: %d", errno);
		zsock_close(sock);
		return -errno;
	}

	return sock;
}

int llm_chat(llm_messages_cb_t messages_cb, llm_tools_cb_t tools_cb, struct llm_response *resp,
	     void *args)
{
	static const char *referer_header = "HTTP-Referer: https://github.com/LingaoM/zbot\r\n";
	static const char *content_type = "Content-Type: application/json\r\n";
	static const char *title_header = "X-Title: zbot tests\r\n";
	static char provider_header[CONFIG_PROVIDER_ID_MAX_LEN + 32];
	static char auth_header[CONFIG_API_KEY_MAX_LEN + 32];
	static char req_body[LLM_BUF_LEN];
	const struct llm_config *cfg;
	int body_len, sock, rc;

	if (!messages_cb || !resp) {
		return -EINVAL;
	}

	cfg = config_get();

	if (!config_has_api_key()) {
		LOG_ERR("API key not set. Use: zbot key <your-api-key>");
		return -EACCES;
	}

	/* Build request body */
	body_len = build_request_body(messages_cb, tools_cb, req_body, sizeof(req_body), args);
	if (body_len < 0) {
		LOG_ERR("Failed to build request body: %d", body_len);
		return body_len;
	}

	/* Connect */
	sock = resolve_and_connect(cfg);
	if (sock < 0) {
		return sock;
	}

	/* Build Authorization header */
	snprintf(auth_header, sizeof(auth_header), "Authorization: Bearer %s\r\n", cfg->api_key);

	/* NOTE: Do NOT set Content-Length manually — Zephyr HTTP client adds it
	 * automatically from payload_len. A duplicate Content-Length causes HTTP 400. */

	/* Build X-Model-Provider-Id header (only if provider_id is set) */
	provider_header[0] = '\0';
	if (cfg->provider_id[0] != '\0') {
		snprintf(provider_header, sizeof(provider_header), "X-Model-Provider-Id: %s\r\n",
			 cfg->provider_id);
	}

	/* Prepare HTTP request */
	const char *extra_headers[] = {
		auth_header,
		content_type,
		referer_header,
		title_header,
		cfg->provider_id[0] ? provider_header : NULL,
		NULL,
	};

	/* Prepare receive buffer and response struct */
	memset(req_body, 0, sizeof(req_body));

	struct http_request req = {0};
	req.method = HTTP_POST;
	req.url = cfg->endpoint_path;
	req.host = cfg->endpoint_host;
	req.protocol = "HTTP/1.1";
	req.header_fields = extra_headers;
	req.payload = req_body;
	req.payload_len = (size_t)body_len;
	req.recv_buf = req_body;
	req.recv_buf_len = sizeof(req_body) - 1;

	LOG_INF("Sending LLM request to %s%s", cfg->endpoint_host, cfg->endpoint_path);

	rc = http_client_req(sock, &req, LLM_HTTP_TIMEOUT_MS, NULL);
	zsock_close(sock);

	if (rc < 0) {
		LOG_ERR("HTTP request failed: %d", rc);
		return rc;
	}

	resp->http_status = req.internal.response.http_status_code;

	/* Parse the response JSON */
	rc = parse_llm_response(req_body, resp);
	return rc;
}
```

## src/llm_client.h
```c
/*
 * Copyright (c) 2026 Lingao Meng
 *
 * SPDX-License-Identifier: Apache-2.0
 *
 * ZBot - LLM Client Module
 *
 * Sends HTTP POST requests to an OpenAI-compatible Chat Completions API
 * using Zephyr's HTTP client. The API key is taken from config at
 * call-time — it is never stored in flash.
 *
 * Response format: the module parses the JSON response and extracts
 * the assistant's message content and any tool_calls.
 */

#ifndef ZBOT_LLM_CLIENT_H
#define ZBOT_LLM_CLIENT_H

#include <stddef.h>
#include <stdbool.h>

#ifdef __cplusplus
extern "C" {
#endif

/* Maximum sizes */
#define LLM_REQUEST_BUF_LEN   4096
#define LLM_RESPONSE_BUF_LEN  4096
#define LLM_BUF_LEN           MAX(LLM_REQUEST_BUF_LEN, LLM_RESPONSE_BUF_LEN)
#define LLM_CONTENT_MAX_LEN   2048
#define LLM_TOOL_NAME_MAX_LEN 64
#define LLM_TOOL_ARGS_MAX_LEN 512

/** finish_reason values */
#define LLM_FINISH_STOP      0
#define LLM_FINISH_TOOL_CALL 1
#define LLM_FINISH_LENGTH    2
#define LLM_FINISH_ERROR     -1

/** A parsed tool call from the LLM response */
struct llm_tool_call {
	char id[32];
	char name[LLM_TOOL_NAME_MAX_LEN];
	char arguments[LLM_TOOL_ARGS_MAX_LEN];
};

/** Parsed LLM response */
struct llm_response {
	/* Text content of the assistant message (may be empty on tool call) */
	char content[LLM_CONTENT_MAX_LEN];

	/* Tool call (valid when finish_reason == LLM_FINISH_TOOL_CALL) */
	struct llm_tool_call tool_call;
	bool has_tool_call;

	/* finish_reason: LLM_FINISH_* */
	int finish_reason;

	/* HTTP status code received */
	int http_status;
};

/**
 * @brief Callback to fill the messages JSON array into @p buf.
 * @param args  Caller-supplied context pointer passed through from llm_chat().
 * @return bytes written (>0), or negative errno on error.
 */
typedef int (*llm_messages_cb_t)(char *buf, size_t buf_len, void *args);

/**
 * @brief Callback to fill the tools JSON array into @p buf.
 * @param args  Caller-supplied context pointer passed through from llm_chat().
 * @return bytes written (>0), 0 if no tools, or negative errno on error.
 */
typedef int (*llm_tools_cb_t)(char *buf, size_t buf_len, void *args);

/**
 * @brief Send a chat completion request to the LLM.
 *
 * Calls @p messages_cb and @p tools_cb to write JSON directly into the
 * request buffer, then sends the request and parses the response.
 *
 * @param messages_cb  Callback that writes the messages JSON array.
 * @param tools_cb     Callback that writes the tools JSON array, or NULL.
 * @param resp         Output: parsed response.
 * @param args         Opaque pointer forwarded to both callbacks.
 * @return 0 on success, negative errno on error.
 */
int llm_chat(llm_messages_cb_t messages_cb, llm_tools_cb_t tools_cb, struct llm_response *resp,
	     void *args);

#ifdef __cplusplus
}
#endif

#endif /* ZBOT_LLM_CLIENT_H */
```
